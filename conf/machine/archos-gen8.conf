## conf/machine/archos-gen8.conf
```bitbake
#@TYPE: Machine
#@NAME: OMAP3 based Archos Gen 8
#@DESCRIPTION: Machine configuration for the Archos Gen8 devices

TARGET_ARCH = "arm"
require conf/machine/include/omap3.inc

ASSUME_PROVIDED += "u-boot"

PREFERRED_PROVIDER_virtual/xserver = "xserver-xorg"
XSERVER = "xserver-xorg \
           xf86-input-evdev \
           xf86-input-mouse \
           xf86-input-tslib \
           xf86-video-omapfb \
           xf86-input-keyboard"

#What is the correct one, both seem in use?
MACHINE_GUI_CLASS = "bigscreen"
GUI_MACHINE_CLASS = "bigscreen"

#1024 * 600 Widescreen
MACHINE_DISPLAY_WIDTH_PIXELS = "1024"
MACHINE_DISPLAY_HEIGHT_PIXELS = "600"

KERNEL_IMAGETYPE = "zImage"

PREFERRED_PROVIDER_virtual/kernel = "linux-omap-archos"

# Ship all kernel modules
MACHINE_EXTRA_RRECOMMENDS = "kernel-modules"

IMAGE_FSTYPES = "ext3"
EXTRA_IMAGECMD_jffs2 = "-lnp "

SERIAL_CONSOLE = "115200 ttyS2"

MACHINE_FEATURES = "kernel26 apm alsa bluetooth usbgadget usbhost keyboard vfat ext2 screen touchscreen wifi"
```
